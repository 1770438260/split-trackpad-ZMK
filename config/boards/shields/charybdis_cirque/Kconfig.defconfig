## config/boards/shields/charybdis_cirque/Kconfig.defconfig
```kconfig
if SHIELD_CHARYBDIS_CIRQUE_LEFT

    config ZMK_KEYBOARD_NAME
        default "charybdis_cirque"
    
    config ZMK_SPLIT_BLE_ROLE_CENTRAL
        default y

endif

if SHIELD_CHARYBDIS_CIRQUE_LEFT || SHIELD_CHARYBDIS_CIRQUE_RIGHT

config ZMK_SPLIT
    default y

endif
```
